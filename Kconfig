## Kconfig
```kconfig
config USR_LIB_FIDOSTORAGE
bool  "FIDO storage abstraction stack"
  default y
  select USR_LIB_AES
  select USR_LIB_SD
  ---help---
  Support for FIDO-oriented encrypted storage backend

if USR_LIB_FIDO

menu "libfidostorage options"

config USR_LIB_FIDOSTORAGE_DEBUG
  bool "libfidostorage debug informations level"
  default n
  ---help---
  FIDO storage stack debug activation.

config USR_LIB_FIDOSTORAGE_PERFS
  bool "libfidostorage access times measurements and dump"
  default n
  ---help---
  FIDO storage access time (including (de|en)cryption time calculation and pretty printing.


endmenu

endif
```
